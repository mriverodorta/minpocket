## production/configs/minpocket_mp1_defconfig
```kconfig
BR2_aarch64=y
BR2_cortex_a55=y
BR2_TOOLCHAIN_BUILDROOT_MUSL=y
BR2_INIT_NONE=y
BR2_SYSTEM_BIN_SH_NONE=y
BR2_ROOTFS_DEVICE_CREATION_DYNAMIC_DEVTMPFS=y
BR2_TARGET_GENERIC_HOSTNAME="minpocket"
BR2_TARGET_GENERIC_ISSUE="MinPocket"
# BR2_PACKAGE_BUSYBOX is not set
BR2_PACKAGE_MINPOCKET_LAUNCHER=y
BR2_TARGET_ROOTFS_CPIO=y
BR2_TARGET_ROOTFS_CPIO_GZIP=y
# BR2_TARGET_ROOTFS_TAR is not set
BR2_PACKAGE_UTIL_LINUX=y
BR2_PACKAGE_UTIL_LINUX_LIBFDISK=y
BR2_PACKAGE_EXFATPROGS=y
```

## production/package/minpocket-launcher/Config.in
```kconfig
config BR2_PACKAGE_MINPOCKET_LAUNCHER
	bool "MinPocket launcher"
	depends on BR2_aarch64
	depends on BR2_TOOLCHAIN_HAS_THREADS
	select BR2_PACKAGE_LIBDRM
	help
	  Native DRM launcher and PID 1 for the MiniLoong Pocket 1.
```
